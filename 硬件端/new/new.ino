
#include <ESP8266.h>

#ifdef ESP32
#error "This code is not recommended to run on the ESP32 platform! Please check your Tools->Board setting."
#endif

/**
**CoreUSB UART Port: [Serial1] [D0,D1]
**Core+ UART Port: [Serial1] [D2,D3]
**/
#if defined(__AVR_ATmega32U4__) || defined(__AVR_ATmega1284P__) || defined (__AVR_ATmega644P__) || defined(__AVR_ATmega128RFA1__)
#define EspSerial Serial1
#define UARTSPEED  115200
#endif

/**
**Core UART Port: [SoftSerial] [D2,D3]
**/
#if defined (__AVR_ATmega168__) || defined (__AVR_ATmega328__) || defined (__AVR_ATmega328P__)
#include <SoftwareSerial.h>
SoftwareSerial mySerial(2, 3); /* RX:D2, TX:D3 */

#define EspSerial mySerial
#define UARTSPEED  9600
#endif

#define SSID        F("nova 4e")
#define PASSWORD    F("00000000")
#define HOST_NAME   F("api.heclouds.com")
#define HOST_PORT   (80)

static const byte  GETDATA[]  PROGMEM = {
//   "GET https://api.heclouds.com/devices/562085140/datapoints?datastream_id=a&limit=1 "
//};//关键头文件
 "GET https://api.heclouds.com/devices/562085140/datapoints?datastream_id=a&limit=1 HTTP/1.1\r\nHost:api.heclouds.com\r\napi-key:X23veW4=d14jBJgdyQTaxTcTilw=\r\nConnection: close\r\n\r\n"
// "GET https://api.heclouds.com/devices/23334240/datapoints?datastream_id=id,status,precent&limit=1 "
};
ESP8266 wifi(&EspSerial);


#include <U8glib.h>
const unsigned char PROGMEM ri1[] = {
0x00,0x00,0x00,0x00,0x00,0x00,0x00,0x00,0x00,0x00,0x00,0x00,0x00,0x00,0x00,0x00,
0x00,0x00,0x00,0x00,0x00,0x00,0x00,0x00,0x00,0x00,0x00,0x00,0x00,0x00,0x00,0x00,
0x00,0x00,0x00,0x00,0x00,0x00,0x00,0x00,0x00,0x00,0x00,0x00,0x00,0x00,0x00,0x00,
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0x00,0x00,0x00,0x00,0x00,0x00,0x00,0x00,0x00,0x00,0x00,0x00,0x00,0x00,0x00,0x00


};
const unsigned char PROGMEM ri2[] = {
0x00,0x00,0x00,0x00,0x00,0x00,0x00,0x00,0x00,0x00,0x00,0x00,0x00,0x00,0x00,0x00,
0x00,0x00,0x00,0x00,0x00,0x00,0x00,0x00,0x00,0x00,0x00,0x00,0x00,0x00,0x00,0x00,
0x00,0x00,0x00,0x00,0x00,0x00,0x00,0x00,0x00,0x00,0x00,0x00,0x00,0x00,0x00,0x00,
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0x00,0x00,0x00,0x00,0x00,0x00,0x00,0x00,0x00,0x00,0x00,0x00,0x00,0x00,0x00,0x00

};
#define INTERVAL_LCD             20             //定义OLED刷新时间间隔  
unsigned long lcd_time = millis();                 //OLED刷新时间计时器
U8GLIB_SSD1306_128X64 u8g(U8G_I2C_OPT_NONE);     //设置OLED型号  
//-------字体设置，大、中、小
#define setFont_L u8g.setFont(u8g_font_7x13)
#define setFont_M u8g.setFont(u8g_font_fixed_v0r)
#define setFont_S u8g.setFont(u8g_font_fixed_v0r)
#define setFont_SS u8g.setFont(u8g_font_fub25n)



#define  sensorPin  6
int state;


#include "pitches.h"
#define buzzer_pin 8
//基本音符:
int melody[] = {
  NOTE_C4, NOTE_C4, NOTE_D4,NOTE_C4, NOTE_F4, NOTE_E4,0, NOTE_C4, NOTE_C4, NOTE_D4,NOTE_C4, NOTE_G4, NOTE_F4,0, NOTE_C4, NOTE_C4, NOTE_C5, NOTE_A4, NOTE_F4, NOTE_E4, NOTE_D4,0, NOTE_B4, NOTE_B4, NOTE_A4, NOTE_F4, NOTE_G4, NOTE_F4
};
// 4代表四分音符，8代表8分音符，以此类推:
int noteDurations[] = {
  8,8,4,4,4,4,4,8,8,4,4,4,4,4,8,8,4,4,4,4,4,4,8,8,4,4,4,2
};






char a;
void setup(void)
{
  Serial.begin(115200);
  while (!Serial); // wait for Leonardo enumeration, others continue immediately
  Serial.print(F("setup begin\r\n"));
  delay(100);

  WifiInit(EspSerial, UARTSPEED);

  Serial.print(F("FW Version:"));
  Serial.println(wifi.getVersion().c_str());

  if (wifi.setOprToStationSoftAP()) {
    Serial.print(F("to station + softap ok\r\n"));
  } else {
    Serial.print(F("to station + softap err\r\n"));
  }

  if (wifi.joinAP(SSID, PASSWORD)) {
    Serial.print(F("Join AP success\r\n"));

    Serial.print(F("IP:"));
    Serial.println( wifi.getLocalIP().c_str());
  } else {
    Serial.print(F("Join AP failure\r\n"));
  }

  if (wifi.disableMUX()) {
    Serial.print(F("single ok\r\n"));
  } else {
    Serial.print(F("single err\r\n"));
  }

  Serial.print(F("setup end\r\n"));







  pinMode(sensorPin, INPUT);
  
}

void loop(void)
{
  if (wifi.createTCP(HOST_NAME, HOST_PORT)) {
    Serial.print(F("create tcp ok\r\n"));
  } else {
    Serial.print(F("create tcp err\r\n"));
 }


  wifi.sendFromFlash(GETDATA, sizeof(GETDATA)); //从Flash读取发送内容，节约内存

  uint8_t buffer[512] = {0};
  uint32_t len = wifi.recv(buffer, sizeof(buffer), 20000);
  if (len > 0) {

for (uint32_t i = 0; i < len-12; i++) {
      if((char)buffer[i]=='v'&&(char)buffer[i+1]=='a'&&(char)buffer[i+2]=='l'&&(char)buffer[i+3]=='u'&&(char)buffer[i+4]=='e')//检测value单词
      {
         a=(char)buffer[i+7];
         break;
    } }}

  if (wifi.releaseTCP()) {
    Serial.print(F("release tcp ok\r\n"));
  } else {
    Serial.print(F("release tcp err\r\n"));
  }








 state = digitalRead(sensorPin);
if(a=='2'){
if (state==1) 
 {
 
Serial.println("主人回来了");

  u8g.firstPage();
  do {
    setFont_M;
    u8g.drawBitmapP(0, 0, 16, 64, ri1);
  }while (u8g.nextPage());
}
 
else 
{ 
Serial.println("主人不在");

  u8g.firstPage();
  do {
    setFont_M;
    u8g.drawBitmapP(30, 0, 8, 64, ri2);
  }while (u8g.nextPage());
}}
if(a=='1')
{
 for (int thisNote = 0; thisNote < 29; thisNote++) {

    // 要根据音符种类计算播放每个音符播放的时间，只需要使用一秒除以音符的种类
    //例如，四分音符播放时间为1000 / 4,八分音符播放时间为=1000/8,以此类推。
    int noteDuration = 2000 / noteDurations[thisNote];
    tone(buzzer_pin, melody[thisNote], noteDuration);

    // 为了让人耳能够分辨清楚每个音符，设置播放每个音符间的最小间隔时间。音符的播放时间*1.3作为间隔时间是比较好的选择:
    int pauseBetweenNotes = noteDuration * 1.30;
    delay(pauseBetweenNotes);
    // stop the tone playing:
    noTone(29);
  }








 


  
  delay(100);
}}

